## configs/cmt_cube_rk3288_defconfig
```kconfig
# configs/cmt_cube_rk3288_defconfig
CONFIG_ARM=y
CONFIG_ARCH_ROCKCHIP=y
CONFIG_SYS_TEXT_BASE=0x01000000
CONFIG_TARGET_EVB_RK3288=y
CONFIG_DEFAULT_DEVICE_TREE="rk3288-cmt-cube"
CONFIG_SPL=y
CONFIG_SPL_STACK_R_ADDR=0x80000
CONFIG_SPL_MMC_SUPPORT=y
CONFIG_CMD_USB=y
CONFIG_DM_VIDEO=y
CONFIG_DISPLAY_MIPI_DSI=y
CONFIG_DRM_ROCKCHIP=y
CONFIG_SPL_LIBCOMMON_SUPPORT=y
CONFIG_SPL_LIBGENERIC_SUPPORT=y
CONFIG_SPL_SERIAL_SUPPORT=y
CONFIG_SPL_DRIVERS_MISC_SUPPORT=y
CONFIG_SPL_GPIO_SUPPORT=y
CONFIG_SPL_I2C_SUPPORT=y
CONFIG_SPL_POWER_SUPPORT=y
CONFIG_SPL_REGULATOR=y
CONFIG_SPL_WATCHDOG_SUPPORT=y
CONFIG_SPL_LOAD_FIT=y
CONFIG_SPL_FIT_GENERATOR="arch/arm/mach-rockchip/make_fit_atf.sh"
```
